## components/ads126xAdc/Kconfig
```kconfig
menu "ADS126x ADC (ADS1262/ADS1263)"

config ADS126X_LOG_LEVEL
    int "Log level (0=none, 4=verbose)"
    range 0 4
    default 3

config ADS126X_SPI_CLOCK_HZ
    int "SPI clock (Hz)"
    default 2000000

config ADS126X_HAS_ADC2
    bool "Enable ADC2 API (ADS1263 only)"
    default y
    help
        ADS1263 has an auxiliary ADC2. ADS1262 does not. When running on
        ADS1262, ADC2 APIs return ESP_ERR_NOT_SUPPORTED.

config ADS126X_HELPER_CREATE_SPI
    bool "Enable helper to create SPI bus/device"
    default n
    help
        Builds ads126xAdcHelperCreateSpiDevice() for quick validation.

endmenu
```

## components/bleTransport/Kconfig
```kconfig
menu "BLE Transport"

config BLE_TRANSPORT_ENABLE
    bool "Enable BLE transport module"
    default y
    depends on SENSORARRAY_ENABLE_BLE

config BLE_TRANSPORT_MTU_TARGET
    int "Target MTU (negotiated)"
    default 247
    depends on BLE_TRANSPORT_ENABLE

config BLE_TRANSPORT_NOTIFY_QUEUE_LEN
    int "Notify queue length"
    default 128
    depends on BLE_TRANSPORT_ENABLE

endmenu
```

## components/fdc2212Cap/Kconfig
```kconfig
menu "FDC2212 (I2C)"

config FDC2212_I2C_ADDR
    hex "I2C address (0x2A or 0x2B)"
    default 0x2A

config FDC2212_CHANNELS
    int "Number of channels used (1 or 2)"
    default 2
    range 1 2

endmenu
```

## components/tmuxSwitch/Kconfig
```kconfig
menu "TMUX Switch"

menu "TMUX1108"

config TMUX1108_A0_GPIO
    int "TMUX1108 A0 GPIO"
    default 4
    help
        GPIO for TMUX1108 A0. Must be set to a valid GPIO.

config TMUX1108_A1_GPIO
    int "TMUX1108 A1 GPIO"
    default 5
    help
        GPIO for TMUX1108 A1. Must be set to a valid GPIO.

config TMUX1108_A2_GPIO
    int "TMUX1108 A2 GPIO"
    default 6
    help
        GPIO for TMUX1108 A2. Must be set to a valid GPIO.

config TMUX1108_SW_GPIO
    int "TMUX1108 SW GPIO (REF/GND select)"
    default 7
    help
        GPIO for SW (REF/GND select) into TMUX1108.

config TMUX1108_SW_REF_LEVEL
    bool "SW high level selects REF (y=high, n=low)"
    default y

config TMUX1108_DEFAULT_SOURCE
    int "Default source (0=GND, 1=REF)"
    range 0 1
    default 0

config TMUX1108_SWITCH_ROW_SAFE_MODE
    bool "Enable safe row switching via SW"
    default y

config TMUX1108_SAFE_SOURCE
    int "Safe source during row switch (0=GND, 1=REF)"
    range 0 1
    default 0
    depends on TMUX1108_SWITCH_ROW_SAFE_MODE

config TMUX1108_SWITCH_DELAY_US
    int "Switch delay (us) when safe mode is enabled"
    range 0 100000
    default 0
    depends on TMUX1108_SWITCH_ROW_SAFE_MODE

endmenu

menu "TMUX1134"

config TMUX1134_SEL1_GPIO
    int "TMUX1134 SEL1 GPIO (SELA)"
    default 1
    help
        GPIO for TMUX1134 SEL1 (SELA). Must be set to a valid GPIO.

config TMUX1134_SEL2_GPIO
    int "TMUX1134 SEL2 GPIO (SELB)"
    default 2
    help
        GPIO for TMUX1134 SEL2 (SELB). Must be set to a valid GPIO.

config TMUX1134_SEL3_GPIO
    int "TMUX1134 SEL3 GPIO (optional)"
    default -1

config TMUX1134_SEL4_GPIO
    int "TMUX1134 SEL4 GPIO (optional)"
    default -1

config TMUX1134_EN_GPIO
    int "TMUX1134 EN GPIO (-1 if tied off)"
    default -1

config TMUX1134_DEFAULT_ALL_OFF
    bool "Default all-off at init (EN off if controllable)"
    default n

config TMUX1134_DEFAULT_SELA_ENABLED
    bool "Default SELA enabled"
    default n

config TMUX1134_DEFAULT_SELB_ENABLED
    bool "Default SELB enabled"
    default n

config TMUX1134_SELA_ENABLED_LEVEL
    int "SELA enabled level (0 or 1)"
    range 0 1
    default 1

config TMUX1134_SELB_ENABLED_LEVEL
    int "SELB enabled level (0 or 1)"
    range 0 1
    default 1

config TMUX1134_EN_OFF_LEVEL
    int "EN off level (0 or 1)"
    range 0 1
    default 0

endmenu

endmenu
```

## components/transportWire/Kconfig
```kconfig
menu "Wired Transport"

config WIRE_UART_ENABLE
    bool "Enable UART transport"
    default y
    depends on SENSORARRAY_ENABLE_WIRED

config WIRE_UART_PORT
    int "UART port"
    default 1
    depends on WIRE_UART_ENABLE

config WIRE_UART_TX_GPIO
    int "UART TX GPIO"
    default 17
    depends on WIRE_UART_ENABLE

config WIRE_UART_RX_GPIO
    int "UART RX GPIO"
    default 18
    depends on WIRE_UART_ENABLE

config WIRE_UART_BAUD
    int "UART baudrate"
    default 2000000
    depends on WIRE_UART_ENABLE

config WIRE_USB_CDC_ENABLE
    bool "Enable USB-CDC transport (optional)"
    default n
    depends on SENSORARRAY_ENABLE_WIRED

endmenu
```

## core/matrixEngine/Kconfig
```kconfig
menu "Matrix Engine"

config MATRIX_ROWS
    int "Rows"
    default SENSORARRAY_MATRIX_ROWS

config MATRIX_COLS
    int "Cols"
    default SENSORARRAY_MATRIX_COLS

config MATRIX_FRAME_PERIOD_MS
    int "Frame period (ms)"
    default SENSORARRAY_FRAME_PERIOD_MS

config MATRIX_OVERSAMPLE
    int "Oversample"
    default SENSORARRAY_OVERSAMPLE

config MATRIX_USE_RINGBUFFER
    bool "Use FreeRTOS ringbuffer for streaming"
    default y

config MATRIX_SCAN_TASK_CORE
    int "Scan task core"
    default SENSORARRAY_SCAN_TASK_CORE
    range 0 1

config MATRIX_COMM_TASK_CORE
    int "Comm task core"
    default SENSORARRAY_COMM_TASK_CORE
    range 0 1

config MATRIX_SCAN_TASK_STACK
    int "Scan task stack"
    default SENSORARRAY_SCAN_TASK_STACK

config MATRIX_SCAN_TASK_PRIO
    int "Scan task priority"
    default SENSORARRAY_SCAN_TASK_PRIO

config MATRIX_COMM_TASK_STACK
    int "Comm task stack"
    default SENSORARRAY_COMM_TASK_STACK

config MATRIX_COMM_TASK_PRIO
    int "Comm task priority"
    default SENSORARRAY_COMM_TASK_PRIO

endmenu
```

## core/powerCtrl/Kconfig
```kconfig
menu "Power Control (EN/PG/IRQ GPIO abstraction)"

config POWER_MAIN_EN_GPIO
    int "Main power enable GPIO (-1 if always on)"
    default -1

config POWER_ANALOG_EN_GPIO
    int "Analog rails enable GPIO (-1 if always on)"
    default -1

config POWER_CHG_STAT_GPIO
    int "Charger status GPIO (-1 if not connected)"
    default -1

config POWER_PG_GPIO
    int "Power-good GPIO (-1 if not connected)"
    default -1

endmenu
```

## transport/protocolWire/Kconfig
```kconfig
menu "Wire Protocol"

config PROTOCOL_ENABLE_CRC16
    bool "Enable CRC16 for frames"
    default y

config PROTOCOL_FRAME_VERSION
    int "Protocol frame version"
    default 1

endmenu
```
