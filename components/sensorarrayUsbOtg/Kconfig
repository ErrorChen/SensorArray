## components/sensorarrayUsbOtg/Kconfig
```kconfig
menu "SensorArray USB data interface"
config SENSORARRAY_USB_OTG
    bool "USB-OTG scientific data/control and independent CDC debug"
    default y
    depends on IDF_TARGET_ESP32S3
    help
        Uses the shared internal PHY exclusively. Serial/JTAG remains the ROM
        download path. The backend below selects dual CDC or vendor bulk.
        Disable for the legacy Serial/JTAG build; never install both stacks.
config SENSORARRAY_USB_OTG_CDC
    bool "Use dual CDC (formal data/control + separate debug)"
    default y
    depends on SENSORARRAY_USB_OTG
    help
        CDC0 carries scientific records and command replies in one ordered
        stream. CDC1 is an independent best-effort debug port. Disable for
        the development vendor-bulk backend, which requires libusb/WinUSB.
endmenu
```

## main/Kconfig.projbuild
```kconfig
menu "SensorArray"
rsource "kconfigs/Kconfig.board"
rsource "kconfigs/Kconfig.runtime"
rsource "kconfigs/Kconfig.output"
rsource "kconfigs/Kconfig.logging"
rsource "kconfigs/Kconfig.expert"
rsource "kconfigs/Kconfig.compat"
config SENSORARRAY_CPU_OWNER_DIAGNOSTICS
    bool "Observe application owners' scheduled runtime (diagnostic image)"
    default n
    depends on !FREERTOS_SMP && !FREERTOS_UNICORE && FREERTOS_GENERATE_RUN_TIME_STATS && FREERTOS_RUN_TIME_COUNTER_TYPE_U64 && FREERTOS_RUN_TIME_STATS_USING_ESP_TIMER
    help
        Sample the seven existing CPU0 work owners at natural checkpoints,
        at most once per second, without adding a task or delay. CPUOWNER?0..6
        reads a bounded published snapshot. Runtime is a switch-out cumulative
        counter, including non-SDK work and possibly ISR time; stale is not
        zero CPU and wall minus runtime is not blocked time. Full runtime/trace
        accounting has system-wide RAM and scheduling overhead. These SDK
        options must be selected explicitly; this option does not select them.
endmenu
```

## main/kconfigs/Kconfig.board
```kconfig
menu "Board"

# Board-level hardware topology and electrical constants. Runtime policy lives in Runtime.
# TMUX GPIO and polarity are defined by the tmuxSwitch component Kconfig.

choice SENSORARRAY_ADS126X_VARIANT
    prompt "ADS126x variant"
    default SENSORARRAY_ADS_AUTO
config SENSORARRAY_ADS_AUTO
    bool "Auto-detect ADS1262/ADS1263 from DEV_ID"
config SENSORARRAY_ADS1262
    bool "ADS1262 (ADC1 only)"
config SENSORARRAY_ADS1263
    bool "ADS1263 (ADC1 + ADC2)"
endchoice

menu "FDC2214 matrix"

config SENSORARRAY_FDC_PRIMARY_I2C_ADDR
    hex "Primary FDC I2C address (D1..D4)"
    default 0x2B

config SENSORARRAY_FDC_SECONDARY_I2C_ADDR
    hex "Secondary FDC I2C address (D5..D8)"
    default 0x2A

config SENSORARRAY_FDC_STARTUP_PROBE
    bool "Probe FDC addresses on startup"
    default y

config SENSORARRAY_FDC_TANK_INDUCTOR_UH
    int "Tank inductor value for optional conversion (uH, 0=unknown)"
    default 0
    range 0 1000000

config SENSORARRAY_FDC_TANK_INDUCTOR_NH
    int "Tank inductor value for MATRIXFDC capTotalPf (nH)"
    default 18000
    range 1 100000000
    help
        Default 18000 nH is 18.000 uH. capTotalPf is derived from freqHz
        in CPU code and does not add FDC I2C transactions.


config SENSORARRAY_FDC_REF_CLOCK_USE_EXTERNAL
    bool "Use external 40MHz CLKIN for FDC2214"
    default y

config SENSORARRAY_FDC_REF_CLOCK_USE_EXTERNAL_VALUE
    int
    default 1 if SENSORARRAY_FDC_REF_CLOCK_USE_EXTERNAL
    default 0

config SENSORARRAY_FDC_EXTERNAL_CLOCK_HZ
    int "FDC external CLKIN frequency Hz"
    default 40000000
    range 2000000 40000000

endmenu


menu "SPI DMA (ADS126x)"

config SENSORARRAY_SPI_USE_DMA
    bool "Enable SPI DMA where possible"
    default y

config SENSORARRAY_SPI_MAX_TRANSFER_BYTES
    int "SPI max transfer size (bytes)"
    default 64

endmenu

menu "ADS startup SPI qualification"

config SENSORARRAY_ADS_GPIO_TAIL_READ_ENABLE
    bool "Require physical GPIO sampling of the ADC1 CRC final bit"
    depends on IDF_TARGET_ESP32S3 && SENSORARRAY_ADS1262 && SENSORARRAY_SPI_USE_DMA
    default n
    help
        Explicit SensorArray board policy: use SPI for the first 55 bits and
        physically sample the last CRC bit before the final falling edge.
        Requires the verified dedicated SPI3 board route and physical
        INTERFACE readback with STATUS, CRC8 and serial timeout disabled.
        Missing capability is an explicit error, not a silent SPI fallback.
        This does not infer or repair a bit from the calculated CRC.
        Ordinary byte-based SPI remains the default for other configurations.

config SENSORARRAY_ADS_SPI_AUTOTUNE_ENABLE
    bool "Qualify ADS SPI clock at boot alongside FDC I2C initialization"
    default y
    help
        Start the ADS at a conservative bootstrap clock, then test descending
        rates no faster than ADS126X_SPI_CLOCK_HZ using verified registers and
        fresh ADC data with CRC and STATUS. Select the fastest rate passing
        both the probe and an independent confirmation. No passing rate or an
        unverified restore is a startup error, never an implicit safe fallback.
        This finite startup test is not a guarantee of zero runtime errors.

config SENSORARRAY_ADS_SPI_AUTOTUNE_BUDGET_MS
    int "Complete SPI qualification budget including restore (ms)"
    default 30000
    range 5000 60000
    help
        One monotonic deadline covers worker dispatch, all rate tests and
        restoration. Existing FDC I2C initialization has its own bounds and
        is not covered by this SPI deadline.

config SENSORARRAY_ADS_SPI_AUTOTUNE_PROBE_SAMPLES
    int "Wire sample attempts in each rate probe"
    default 400
    range 128 2048
    help
        Split between gain-one and PGA-bypass profiles. Each phase total must
        be at least four times MIN_PARITY_SAMPLES; impossible configurations
        are rejected instead of weakening CRC coverage.

config SENSORARRAY_ADS_SPI_AUTOTUNE_CONFIRM_SAMPLES
    int "Independent wire sample attempts before selecting a rate"
    default 1600
    range 128 4096

config SENSORARRAY_ADS_SPI_AUTOTUNE_MIN_PARITY_SAMPLES
    int "Minimum CRC-valid samples of each final-bit parity per phase"
    default 32
    range 1 64
    help
        Require coverage of both zero and one in the computed CRC final bit.
        Fixed saturated responses cannot qualify the bus by repeating a CRC
        whose final bit is always one. Parity is counted only after CRC passes.

config SENSORARRAY_ADS_SPI_AUTOTUNE_MAX_CRC_PERMILLE
    int "Maximum CRC error fraction for each profile and phase (per mille)"
    default 25
    range 0 25
    help
        25 permits at most 2.5 percent CRC-rejected wire samples. The default
        200/800 attempts per profile allow 5/20 CRC errors, respectively.
        Rejected samples never count as valid data, parity coverage or raw
        extrema. Register, reset, status and completion errors still fail.
        Runtime ADC CRC validation is not weakened by this boot criterion.

config SENSORARRAY_ADS_SPI_PROBE_TASK_STACK
    int "Startup SPI worker stack (bytes)"
    default 6144
    range 4096 16384

endmenu

menu "ADS1263 direct diagnostics / gap fill"

config SENSORARRAY_ADS_GAP_FILL_ENABLE
    bool "Run AIN8/AIN9 direct diagnostics inside FDC ready windows"
    default y

config SENSORARRAY_ADS_START_GPIO
    int "ADS1263 START GPIO"
    default 48
    range 0 48

config SENSORARRAY_ADS_DRDY_GPIO
    int "ADS1263 DRDY GPIO"
    default 13
    range 0 48

config SENSORARRAY_ADS_DATA_RATE
    int "ADS1263 ADC1 data-rate register code"
    default 15
    range 0 15
    help
        15 selects 38400 SPS for ADC1. Auxiliary transactions must follow
        the capabilities of the identified ADC device.

config SENSORARRAY_ADS_GAP_GUARD_US
    int "Initial FDC deadline guard for ADS gap-fill (us)"
    default 500
    range 100 10000

config SENSORARRAY_ADS_JOB_WORST_CASE_US
    int "ADS direct-job admission worst case (us)"
    default 4000
    range 100 20000

config SENSORARRAY_ADS_DRDY_TIMEOUT_US
    int "ADS DRDY notification timeout (us)"
    default 600
    range 100 20000

config SENSORARRAY_ADS_AIN8_BATTERY_DIVIDER_NUM
    int "Battery/input ratio numerator for the 1:1 divider"
    default 2
    range 0 100000

config SENSORARRAY_ADS_AIN8_BATTERY_DIVIDER_DEN
    int "AIN8 battery divider denominator"
    default 1
    range 1 100000

config SENSORARRAY_ADS_BATTERY_MIN_MV
    int "Minimum plausible battery voltage (mV)"
    default 2500
    range 0 20000

config SENSORARRAY_ADS_BATTERY_MAX_MV
    int "Maximum plausible battery voltage (mV)"
    default 5000
    range 0 20000

config SENSORARRAY_BATTERY_ENABLE
    bool "Enable periodic AIN8 battery measurement"
    default y

config SENSORARRAY_BATTERY_PERIOD_MS
    int "Battery sampling period (ms)"
    default 1000
    range 100 600000

config SENSORARRAY_BATTERY_MAX_DEFER_MS
    int "Maximum battery gap deferral before frame-boundary fallback (ms)"
    default 3000
    range 100 600000

config SENSORARRAY_BATTERY_MAX_AGE_MS
    int "Maximum age of a fresh battery result (ms)"
    default 5000
    range 100 600000

config SENSORARRAY_BATTERY_CALIBRATION_SCALE_PPM
    int "Battery calibration scale (ppm, 1000000 is unity)"
    default 1000000
    range 500000 1500000

config SENSORARRAY_BATTERY_CALIBRATION_OFFSET_UV
    int "Battery calibration offset (uV)"
    default 0
    range -1000000 1000000

config SENSORARRAY_BATTERY_VBIAS_SETTLE_US
    int "Battery VBIAS and input-MUX settle guard (us)"
    default 50
    range 0 100000
    help
        ADS126x battery conversion stabilization guard after VBIAS, reference,
        and AIN8 mux changes. The default is 50 us; one fresh discard
        conversion remains enabled before the three-sample battery result.

config SENSORARRAY_BATTERY_DATA_RATE
    int "Battery ADC1 data-rate code"
    default 9
    range 0 15
    help
        ADS1262 MODE2 data-rate code used only during the frame-boundary or
        admitted CAP-gap AIN8 transaction. The default 9 selects 1200 SPS,
        trading a few milliseconds of periodic boundary overhead for the
        materially lower noise verified on ADS1262. One genuinely fresh
        discard plus a three-conversion median and raw spread gate remain
        enabled. The complete matrix core state is restored and read back.

config SENSORARRAY_BATTERY_MAX_SPREAD_RAW
    int "Maximum raw-code spread across three battery samples"
    default 3000000
    range 1 2147483647
    help
        A larger three-sample spread marks the AIN8 result unstable. The
        transaction is still restored and reported, but battery valid remains
        false. This threshold is in ADC raw codes rather than battery volts.
        On the validated 5.188 V reference, 3000000 codes is about 7.25 mV at
        AIN8 or 14.5 mV after the default 2:1 divider. The accepted battery
        voltage must still pass the independent 2500-5000 mV range and rail,
        reference, status, freshness, and restore checks; the wider spread
        gate accommodates the measured boundary-coupled ADC noise while the
        battery is physically connected.

config SENSORARRAY_ADS_AVSS_TO_GND_UV
    int "Magnitude of AVSS below GND (uV)"
    default 1800000
    range 0 5000000

config SENSORARRAY_ADS_AVDD_TO_GND_UV
    int "AVDD above GND (uV)"
    default 3300000
    range 0 5000000
    help
        With ADS126x AINCOM level shift enabled, AINCOM-to-GND is calculated
        explicitly as the AVDD/AVSS midpoint. A validated measured rail scales
        the nominal AVDD-to-GND and AVSS-to-GND split before that calculation.

config SENSORARRAY_ADS_RAIL_EXPECTED_TOLERANCE_UV
    int "Allowed rail-monitor error from configured AVDD-AVSS (uV)"
    default 250000
    range 10000 2000000
    help
        The ADS126x analog supply monitor is measured against the internal
        reference and scaled by four. Battery calculation accepts this rail
        only when it is close to AVDD_TO_GND + AVSS_TO_GND.

config SENSORARRAY_ADS_ZERO_PERIOD_FRAMES
    int "AIN9-AINCOM residual measurement period"
    default 100
    range 1 100000

config SENSORARRAY_ADS_RAIL_PERIOD_FRAMES
    int "Analog supply monitor period"
    default 500
    range 1 100000

endmenu

menu "Matrix defaults"

config SENSORARRAY_MATRIX_ROWS
    int "Matrix rows"
    default 8

config SENSORARRAY_MATRIX_COLS
    int "Matrix cols"
    default 8

config SENSORARRAY_OVERSAMPLE
    int "Oversample count per point"
    default 1

config SENSORARRAY_MEASURE_LOCK_TIMEOUT_MS
    int "Measurement lock timeout (ms)"
    default 5000
    range 1 60000

endmenu

menu "I2C recovery"

config SENSORARRAY_I2C_RECOVER_ON_TIMEOUT
    bool "Recover I2C bus after timeout when pins look stuck"
    default n

endmenu

endmenu
```
