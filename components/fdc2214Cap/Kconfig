## main/kconfigs/Kconfig.expert
```kconfig
menu "Expert"

config SENSORARRAY_EXPERT_MODE
    bool "SensorArray expert mode"
    default n

if SENSORARRAY_EXPERT_MODE

config SENSORARRAY_FDC_DEBUG_TIMING_GPIO_ENABLE
    bool "Enable FDC physical timing debug GPIOs"
    default n
    help
        Debug-only oscilloscope markers. When disabled, the scan hot path does
        not configure or toggle any of the GPIOs below.

config SENSORARRAY_FDC_ROW_STROBE_GPIO
    int "Row strobe GPIO"
    default -1
    range -1 48
    depends on SENSORARRAY_FDC_DEBUG_TIMING_GPIO_ENABLE

config SENSORARRAY_FDC_FRAME_STROBE_GPIO
    int "Physical sweep frame strobe GPIO"
    default -1
    range -1 48
    depends on SENSORARRAY_FDC_DEBUG_TIMING_GPIO_ENABLE

config SENSORARRAY_FDC_PRIMARY_READ_WINDOW_GPIO
    int "Primary FDC data-read window GPIO"
    default -1
    range -1 48
    depends on SENSORARRAY_FDC_DEBUG_TIMING_GPIO_ENABLE

config SENSORARRAY_FDC_SECONDARY_READ_WINDOW_GPIO
    int "Secondary FDC data-read window GPIO"
    default -1
    range -1 48
    depends on SENSORARRAY_FDC_DEBUG_TIMING_GPIO_ENABLE

config SENSORARRAY_FDC_DEBUG_STROBE_PULSE_US
    int "Debug strobe pulse width (us)"
    default 2
    range 0 1000
    depends on SENSORARRAY_FDC_DEBUG_TIMING_GPIO_ENABLE

choice SENSORARRAY_FDC_WAVE_DEBUG_MODE
    prompt "FDC S8/wave isolation mode"
    default SENSORARRAY_FDC_WAVE_DEBUG_NORMAL
    help
        Debug-only runtime modes for oscilloscope isolation. Any non-normal
        selection bypasses formal matrix frame publication.

config SENSORARRAY_FDC_WAVE_DEBUG_NORMAL
    bool "Normal 8x8 formal measurement"

config SENSORARRAY_FDC_WAVE_DEBUG_ROUTE_ONLY
    bool "Route-only row scan; both FDCs sleeping"

config SENSORARRAY_FDC_WAVE_DEBUG_ROW_HOLD
    bool "Hold one row; both FDCs active"

config SENSORARRAY_FDC_WAVE_DEBUG_PRIMARY_ONLY
    bool "Scan rows; primary active, secondary sleeping"

config SENSORARRAY_FDC_WAVE_DEBUG_SECONDARY_ONLY
    bool "Scan rows; secondary active, primary sleeping"

config SENSORARRAY_FDC_WAVE_DEBUG_SINGLE_CHANNEL
    bool "Scan rows; one FDC single channel active"

endchoice

config SENSORARRAY_FDC_WAVE_DEBUG_ROW
    int "Held row S index"
    default 8
    range 1 8
    depends on SENSORARRAY_FDC_WAVE_DEBUG_ROW_HOLD

config SENSORARRAY_FDC_WAVE_DEBUG_SINGLE_CHANNEL_SECONDARY
    bool "Use secondary FDC for single-channel mode"
    default n
    depends on SENSORARRAY_FDC_WAVE_DEBUG_SINGLE_CHANNEL

config SENSORARRAY_FDC_WAVE_DEBUG_CHANNEL
    int "Single-channel FDC channel index"
    default 0
    range 0 3
    depends on SENSORARRAY_FDC_WAVE_DEBUG_SINGLE_CHANNEL

config SENSORARRAY_FDC_WAVE_DEBUG_STEP_MS
    int "Wave debug row/read step period (ms)"
    default 10
    range 1 1000
    depends on !SENSORARRAY_FDC_WAVE_DEBUG_NORMAL

config SENSORARRAY_FDC_MAP_VERIFY_DEBUG
    bool "Print and assert D1-D8 FDC ownership/channel map at startup"
    default n


config SENSORARRAY_FDC_RESCUE_TASK_STACK
    int "Reserved FDC rescue task stack bytes"
    default 12288
    range 4096 32768

config SENSORARRAY_FDC_VERBOSE_REG_DUMP
    bool "Dump FDC registers on boot/rescue failure"
    default y

config SENSORARRAY_FDC_DIAG_DUMP_REGS
    bool "Dump FDC registers while in diagnostic mode"
    default n

config SENSORARRAY_FDC_DIAG_DUMP_INTERVAL_MS
    int "Diagnostic FDC register dump interval (ms)"
    default 5000
    range 100 600000
    depends on SENSORARRAY_FDC_DIAG_DUMP_REGS

config SENSORARRAY_FDC_DIAG_DUMP_SKIP_OFFLINE_BUS
    bool "Skip diagnostic FDC register dump when an I2C bus is offline"
    default y
    depends on SENSORARRAY_FDC_DIAG_DUMP_REGS

config SENSORARRAY_FDC_VERBOSE_SCAN_LOG
    bool "Print verbose per-row FDC scan diagnostics"
    default n

choice SENSORARRAY_FDC_VERIFY_MODE
    prompt "Runtime FDC register readback verify mode"
    default SENSORARRAY_FDC_VERIFY_MODE_STARTUP_ONLY
config SENSORARRAY_FDC_VERIFY_MODE_FULL
    bool "Full runtime verify"
config SENSORARRAY_FDC_VERIFY_MODE_STARTUP_ONLY
    bool "Startup/cache build verify only"
config SENSORARRAY_FDC_VERIFY_MODE_NONE
    bool "No runtime readback verify"
endchoice

config SENSORARRAY_FDC_HIGH_SPEED_PROFILE
    bool "Enable experimental high-speed FDC profile candidates"
    default n
    help
        Legacy sweep/debug gate for lower RCOUNT/SETTLECOUNT candidates. Use
        SENSORARRAY_FDC_DEFAULT_PROFILE to select the normal matrix fallback
        profile. This option does not rescue profile_too_slow by itself.

config SENSORARRAY_FDC_SPEED_PROFILE_SAFE_FAST
    bool "Report precision-guarded safe-fast FDC profile candidates"
    default n
    help
        Report safe-fast candidate status in FDCSPD20. This release deliberately
        does not mutate RCOUNT or SETTLECOUNT at runtime: profile changes require
        a completed precision-guard and rollback controller before they can be
        applied without risking the primary FDC acquisition path.

config SENSORARRAY_FDC_PRECISION_SAFE_SEQUENCE_ENABLE
    bool "Enable precision-safe ordered DATA register sequence probe"
    default y
    help
        Keeps the existing FDC conversion profile and explicitly addresses
        DATA registers 0x00..0x07 in order, while combining repeated-start
        operations into fewer ESP-IDF command submissions. Runtime errors
        permanently fall back to ordered8 until reboot.

config SENSORARRAY_FDC_FORMAL_FAST_PROFILE_ENABLE
    bool "Enable experimental_precision_affecting_profile runtime RCOUNT reduction"
    default n
    help
        Disabled by default. This experimental_precision_affecting_profile
        lowers runtime RCOUNT and can change conversion resolution, noise floor,
        and stability. It is not part of the precision-safe 20 FPS path.

config SENSORARRAY_FDC_FORMAL_FAST_TARGET_ROUND_US
    int "Formal fast profile target autoscan round time (us)"
    default 4000
    range 100 100000

config SENSORARRAY_FDC_PROFILE_TOO_SLOW_WARN_US
    int "Warn when profile autoscan round estimate exceeds this row budget (us)"
    default 6250
    range 100 1000000

config SENSORARRAY_FDC_PROFILE_TOO_SLOW_RESCUE_ENABLE
    bool "Request FDC rescue when cached profile is too slow"
    default n
    help
        Disabled by default. A slow estimated profile is a timing/performance
        diagnostic, not an electrical failure. Rescue should be requested only
        for invalid data, cache missing, timeout, or explicit debug experiments.

config SENSORARRAY_FDC_PFU_LOG_EVERY_N_FRAMES
    int "Repeat unchanged PFU diagnostic every N row-device visits"
    default 100
    range 1 100000

config SENSORARRAY_FDC_TIMING_LOG_EVERY_N_FRAMES
    int "Deprecated alias for verbose timing output interval"
    default SENSORARRAY_FDC_TIMING_SUMMARY_EVERY_N_FRAMES
    range 0 10000

config SENSORARRAY_FDC_DIRECT_QUALITY_SAMPLES
    int "Direct-read quality sample count"
    default 6
    range 4 8

endif

endmenu
```

## main/kconfigs/Kconfig.logging
```kconfig
menu "Logging"

choice SENSORARRAY_LOG_PROFILE
    prompt "Log profile"
    default SENSORARRAY_LOG_PROFILE_NORMAL
config SENSORARRAY_LOG_PROFILE_QUIET
    bool "Quiet"
config SENSORARRAY_LOG_PROFILE_NORMAL
    bool "Normal"
config SENSORARRAY_LOG_PROFILE_DIAGNOSTIC
    bool "Diagnostic"
config SENSORARRAY_LOG_PROFILE_VERBOSE
    bool "Verbose"
endchoice

config SENSORARRAY_LOG_PERIOD_FRAMES
    int "Log summary period in frames"
    default 50
    range 1 1000

config SENSORARRAY_LOG_SHORT_FIELDS
    bool "Use compact short-field logs"
    default y

choice SENSORARRAY_FDC_LOG_FORMAT
    prompt "FDC diagnostic log format"
    default SENSORARRAY_FDC_LOG_FORMAT_COMPACT
config SENSORARRAY_FDC_LOG_FORMAT_VERBOSE
    bool "Verbose key=value diagnostics"
config SENSORARRAY_FDC_LOG_FORMAT_COMPACT
    bool "Compact token diagnostics"
endchoice

choice SENSORARRAY_LOG_FORMAT
    prompt "SensorArray runtime log format"
    default SENSORARRAY_LOG_FORMAT_COMPACT_KV
config SENSORARRAY_LOG_FORMAT_LEGACY
    bool "Legacy verbose logs"
config SENSORARRAY_LOG_FORMAT_COMPACT_KV
    bool "Compact key=value logs"
config SENSORARRAY_LOG_FORMAT_COMPACT_CSV
    bool "Compact CSV logs"
endchoice

config SENSORARRAY_LOG_OMIT_DEFAULT_FIELDS
    bool "Omit default masks and sentinel fields from compact normal logs"
    default y

config SENSORARRAY_LOG_MASK_SHORT_FORM
    bool "Use compact mask shorthand in logs"
    default y

config SENSORARRAY_FDC_ROW_LOG_LEVEL
    int "FDC row log level (0 off, 1 anomaly, 2 sampled, 3 verbose compact, 4 legacy verbose)"
    default 1
    range 0 4

config SENSORARRAY_FDC_DEVICE_READ4_LOG_LEVEL
    int "FDC read4 log level (0 off, 1 anomaly, 2 sampled, 3 sampled raw/freq, 4 every read)"
    default 0
    range 0 4

config SENSORARRAY_FDC_LOG_READY_EVERY_ROW
    bool "Print FDC ready diagnostics for every row"
    default n

config SENSORARRAY_FDC_LOG_ROW_PARALLEL_TIMING
    bool "Print per-row FDC parallel overlap timing"
    default n

config SENSORARRAY_FDC_ROW_VERBOSE_LOG
    bool "Print compact FE/FR row diagnostics"
    default y

config SENSORARRAY_OUTPUT_LEGACY_MATRIXFDC_CAP
    bool "Use legacy MATRIXFDC_CAP output tag"
    default n

config SENSORARRAY_FDC_DIFF_CACHE_APPLY
    bool "Apply only changed FDC row cache registers"
    default y

config SENSORARRAY_FDC_CACHE_APPLY_VERBOSE_LOG
    bool "Print verbose cache no-diff/skipped logs"
    default n


config SENSORARRAY_FDC_SAMPLE_DEVICE_LOG_EVERY_N_FRAMES
    int "Sample normal FDC row/device diagnostics every N frames"
    default 0
    range 0 10000
    help
        0 disables sampled normal-path diagnostics. Exceptional timeout,
        stale, duplicate, I2C error and fallback diagnostics are still printed.

config SENSORARRAY_FDC_LOG_NORMAL_POLL_SUCCESS
    bool "Print normal full-poll success diagnostics"
    default n

config SENSORARRAY_LOG_FRAME_SUMMARY
    bool "Print formal FDC frame summary"
    default y

config SENSORARRAY_LOG_FRAME_SUMMARY_EVERY_N_FRAMES
    int "Compact frame summary period in MATRIXFDC frames"
    default 20
    range 0 10000

config SENSORARRAY_LOG_FRAME_SUMMARY_ON_ANOMALY
    bool "Print frame summary immediately on anomaly"
    default y

config SENSORARRAY_LOG_FRAME_OUTPUT_LEGACY
    bool "Print legacy FDC_FRAME_OUTPUT every frame"
    default n

config SENSORARRAY_LOG_ROW_SUMMARY
    bool "Print formal FDC row summary"
    default n

config SENSORARRAY_LOG_I2C_STATS_EVERY_N_FRAMES
    int "BOARD_I2C_STATS aggregate period in MATRIXFDC frames"
    default 20
    range 0 10000

config SENSORARRAY_LOG_TIMING_STATS_EVERY_N_FRAMES
    int "FDC_TIMING_STATS aggregate period in MATRIXFDC frames"
    default 20
    range 0 10000

config SENSORARRAY_LOG_LOW_LEVEL_I2C_XFER
    bool "Print every board-level I2C transaction"
    default n

config SENSORARRAY_LOG_FDC_REGISTER_TRACE
    bool "Print FDC register trace"
    default n

config SENSORARRAY_LOG_SWEEP_CANDIDATE_VERBOSE
    bool "Print every sweep candidate detail"
    default n

config SENSORARRAY_LOG_WORKER_VERBOSE
    bool "Print verbose FDC worker logs"
    default n

config SENSORARRAY_LOG_CACHE_APPLY_VERBOSE
    bool "Print verbose FDC cache apply details"
    default n

config SENSORARRAY_FDC_ALLOW_SAFE_DEFAULT_FORMAL_READ
    bool "Allow safe-default FDC row configs in formal reads"
    default n
    help
        Keep disabled for normal operation: uncalibrated cells are marked
        invalid and scheduled for rescue instead of being read as normal data.

config SENSORARRAY_FDC_RAW_DEBUG_LOG
    bool "Print DEBUGFDC_RAW alongside MATRIXFDC"
    default n

config SENSORARRAY_FDC_TIMING_SUMMARY_EVERY_N_FRAMES
    int "FDC timing summary output interval in MATRIXFDC frames"
    default 20
    range 0 10000

config SENSORARRAY_FDC_TIMING_SUMMARY_PERIOD_FRAMES
    int "FDC compact timing aggregate period in MATRIXFDC frames"
    default 20
    range 0 10000

config SENSORARRAY_FDC_PROFILE_LOG_EVERY_N_FRAMES
    int "FDC profile compact summary period in MATRIXFDC frames"
    default 20
    range 0 10000

config SENSORARRAY_FDC_READY_LOG_EVERY_N_FRAMES
    int "FDC ready compact summary period in MATRIXFDC frames"
    default 20
    range 0 10000

config SENSORARRAY_FDC_TIMING_COMPACT_EVERY_N_FRAMES
    int "FDC compact timing summary period in MATRIXFDC frames"
    default 20
    range 0 10000

config SENSORARRAY_FDC_QUALITY_LOG_EVERY_N_FRAMES
    int "FDC quality/sweep compact summary period in MATRIXFDC frames"
    default 20
    range 0 10000

config SENSORARRAY_FDC_I2C_LOG_EVERY_N_FRAMES
    int "FDC I2C compact summary period in MATRIXFDC frames"
    default 20
    range 0 10000

config SENSORARRAY_ADS_RAIL_INVALID_STREAK_LIMIT
    int "Consecutive invalid rail samples before battery is invalid"
    default 3
    range 1 1000
    help
        A runtime rail monitor sample that is hardware-plausible but outside
        the nominal tolerance reports rv=0, rs=hold and keeps the last-good rail
        for battery math. Clearly out-of-range rail samples hold only until this
        threshold or the age limit is exceeded.

config SENSORARRAY_ADS_RAIL_LAST_GOOD_MAX_AGE_FRAMES
    int "Maximum age of last-good rail for battery math"
    default 500
    range 1 100000

config SENSORARRAY_FDC_TIMING_SUMMARY_AGGREGATE
    bool "Aggregate FDC timing summary over multiple frames"
    default y

config SENSORARRAY_FDC_TIMING_OVERRUN_IMMEDIATE_LOG
    bool "Print compact bottleneck on frame overrun"
    default y

config SENSORARRAY_FDC_OVERRUN_HARD_US
    int "Hard overrun threshold for immediate OV/BN output (us)"
    default 250000
    range 1000 5000000
    help
        Stable FDC frames above the target budget are summarized in OV20/BN20.
        Only frames above this hard threshold use immediate synchronous output.

config SENSORARRAY_FDC_TIMING_VERBOSE_PER_FRAME
    bool "Print per-frame timing summary"
    default n

config SENSORARRAY_FDC_PROFILE_ROW_DEFAULT
    bool "Print SCAN_ROW_TIMING by default"
    default n

config SENSORARRAY_FDC_PROFILE_DEVICE_DEFAULT
    bool "Print SCAN_DEVICE_TIMING by default"
    default n

config SENSORARRAY_FDC_I2C_TRACE_RING_SIZE
    int "FDC I2C trace ring size"
    default 128
    range 0 1024

endmenu
```
