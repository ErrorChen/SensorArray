## components/fdc2214Cap/Kconfig
```kconfig
menu "FDC2214Cap"

config FDC2214CAP_ENABLE
    bool "Enable FDC2214Cap component"
    default y

config FDC2214CAP_LOG_LEVEL
    int "Log level (0=none, 4=verbose)"
    range 0 4
    default 3
    depends on FDC2214CAP_ENABLE

config FDC2214CAP_MUTEX_TIMEOUT_MS
    int "Mutex lock timeout (ms)"
    range 1 10000
    default 200
    depends on FDC2214CAP_ENABLE
    help
        Finite timeout for internal driver mutex lock. Prevents indefinite waits.

config FDC2214CAP_LOW_LEVEL_I2C_TRACE
    bool "Trace every low-level FDC I2C transaction"
    default n
    depends on FDC2214CAP_ENABLE
    help
        Verbose printf trace for every FDC2214 I2C transaction. Keep disabled
        for normal matrix reads because it can saturate the serial monitor.

config FDC2214CAP_RAW_I2C_TRACE
    bool "Trace raw FDC2214 register reads/writes"
    default n
    depends on FDC2214CAP_ENABLE
    help
        Optional raw register trace for driver diagnostics only.

config FDC2214CAP_I2C_ADDR
    hex "I2C address (0x2A or 0x2B)"
    default 0x2A

config FDC2214CAP_CHANNELS
    int "Number of channels used (1..4)"
    default 4
    range 1 4


endmenu
```

## core/boardSupport/Kconfig
```kconfig
menu "Board Support (Pins/Buses)"

menu "I2C0 (SDA0/SCL0)"
config BOARD_I2C_PORT
    int "I2C port"
    range 0 1
    default 0

config BOARD_I2C_SDA_GPIO
    int "I2C SDA GPIO"
    default 9

config BOARD_I2C_SCL_GPIO
    int "I2C SCL GPIO"
    default 10

config BOARD_I2C_FREQ_HZ
    int "Legacy shared I2C frequency fallback (Hz)"
    default 337500
    help
        Compatibility fallback used when per-bus frequencies are not configured.

config BOARD_I2C_AUTO_FALLBACK_ENABLE
    bool "Enable I2C clock probe and fallback"
    default y

config BOARD_I2C_FALLBACK_LEVELS
    string "Documented I2C fallback levels"
    default "350000,337500,325000,300000"
    help
        The firmware probes these fixed levels in order during FDC bring-up.

config BOARD_I2C_PRIMARY_CLK_HZ_DEFAULT
    int "Primary I2C probe starting frequency (Hz)"
    default 350000
    range 100000 1000000

config BOARD_I2C_SECONDARY_CLK_HZ_DEFAULT
    int "Secondary I2C probe starting frequency (Hz)"
    default 350000
    range 100000 1000000

config BOARD_I2C_RUNTIME_FALLBACK_ERROR_FRAMES
    int "Consecutive runtime I2C error frames before fallback is allowed"
    default 3
    range 1 32

config BOARD_I2C_FREQ_HZ_TEST_337500
    bool "Document/test 337500 Hz I2C setting"
    default y

config BOARD_I2C_FREQ_HZ_TEST_350000
    bool "Document/test 350000 Hz I2C setting"
    default n

config BOARD_I2C_FREQ_HZ_TEST_375000
    bool "Document/test 375000 Hz I2C setting"
    default n

config BOARD_I2C_FREQ_HZ_TEST_400000
    bool "Document/test 400000 Hz I2C setting"
    default n

config BOARD_I2C0_FREQ_HZ
    int "I2C0 requested frequency (Hz)"
    default BOARD_I2C_FREQ_HZ

config BOARD_I2C1_FREQ_HZ
    int "I2C1 requested frequency (Hz)"
    default BOARD_I2C_FREQ_HZ

endmenu

menu "I2C2 (SDA2/SCL2, optional)"
config BOARD_I2C1_ENABLE
    bool "Enable secondary I2C bus"
    default y

config BOARD_I2C1_PORT
    int "I2C1 port (optional second bus)"
    range 0 1
    default 1

config BOARD_I2C1_SDA_GPIO
    int "I2C1 SDA GPIO (optional second bus)"
    default 11

config BOARD_I2C1_SCL_GPIO
    int "I2C1 SCL GPIO (optional second bus)"
    default 12
endmenu

menu "I2C recovery"

config SENSORARRAY_I2C_RECOVERY_ENABLED
    bool "Enable guarded I2C bus recovery"
    default y
    help
        Recovery is only attempted after an I2C timeout when SDA or SCL is
        confirmed low. Device NACKs do not delete or reinstall the driver.

config SENSORARRAY_I2C_RECOVERY_COOLDOWN_MS
    int "I2C recovery cooldown (ms)"
    default 1000
    range 0 600000

config SENSORARRAY_I2C_RECOVERY_MAX_FAILS
    int "I2C recovery failures before marking bus offline"
    default 3
    range 1 32

config SENSORARRAY_I2C_RECOVERY_TOGGLE_CLOCKS
    int "SCL pulses during I2C recovery"
    default 9
    range 1 32

endmenu

menu "SPI (ADS126x)"
config BOARD_SPI_HOST
    int "SPI host device (platform-specific)"
    default 2

config BOARD_SPI_SCLK_GPIO
    int "SPI SCLK GPIO"
    default 47

config BOARD_SPI_MOSI_GPIO
    int "SPI MOSI GPIO (ADS126x DIN)"
    default 21

config BOARD_SPI_MISO_GPIO
    int "SPI MISO GPIO (ADS126x DOUT)"
    default 14

config BOARD_ADS126X_CS_GPIO
    int "ADS126x CS GPIO (-1 if tied low)"
    default -1

config BOARD_ADS126X_DRDY_GPIO
    int "ADS126x DRDY GPIO (-1 if unused)"
    default 13

config BOARD_ADS126X_START_GPIO
    int "ADS126x START GPIO (-1 if unused)"
    default 48

config BOARD_ADS126X_RESET_GPIO
    int "ADS126x PWDN/RESET GPIO (-1 if unused)"
    default 38
endmenu

endmenu
```

## main/Kconfig.projbuild
```kconfig
menu "SensorArray"
rsource "kconfigs/Kconfig.board"
rsource "kconfigs/Kconfig.runtime"
rsource "kconfigs/Kconfig.output"
rsource "kconfigs/Kconfig.logging"
rsource "kconfigs/Kconfig.expert"
rsource "kconfigs/Kconfig.compat"
endmenu
```

## main/kconfigs/Kconfig.board
```kconfig
menu "Board"

# Board-level hardware topology and electrical constants. Runtime policy lives in Runtime.
# TMUX GPIO and polarity are defined by the tmuxSwitch component Kconfig.

choice SENSORARRAY_ADS126X_VARIANT
    prompt "ADS126x variant"
    default SENSORARRAY_ADS_AUTO
config SENSORARRAY_ADS_AUTO
    bool "Auto-detect ADS1262/ADS1263 from DEV_ID"
config SENSORARRAY_ADS1262
    bool "ADS1262 (ADC1 only)"
config SENSORARRAY_ADS1263
    bool "ADS1263 (ADC1 + ADC2)"
endchoice

menu "FDC2214 matrix"

config SENSORARRAY_FDC_PRIMARY_I2C_ADDR
    hex "Primary FDC I2C address (D1..D4)"
    default 0x2B

config SENSORARRAY_FDC_SECONDARY_I2C_ADDR
    hex "Secondary FDC I2C address (D5..D8)"
    default 0x2A

config SENSORARRAY_FDC_STARTUP_PROBE
    bool "Probe FDC addresses on startup"
    default y

config SENSORARRAY_FDC_TANK_INDUCTOR_UH
    int "Tank inductor value for optional conversion (uH, 0=unknown)"
    default 0
    range 0 1000000

config SENSORARRAY_FDC_TANK_INDUCTOR_NH
    int "Tank inductor value for MATRIXFDC capTotalPf (nH)"
    default 18000
    range 1 100000000
    help
        Default 18000 nH is 18.000 uH. capTotalPf is derived from freqHz
        in CPU code and does not add FDC I2C transactions.


config SENSORARRAY_FDC_REF_CLOCK_USE_EXTERNAL
    bool "Use external 40MHz CLKIN for FDC2214"
    default y

config SENSORARRAY_FDC_REF_CLOCK_USE_EXTERNAL_VALUE
    int
    default 1 if SENSORARRAY_FDC_REF_CLOCK_USE_EXTERNAL
    default 0

config SENSORARRAY_FDC_EXTERNAL_CLOCK_HZ
    int "FDC external CLKIN frequency Hz"
    default 40000000
    range 2000000 40000000

endmenu


menu "SPI DMA (ADS126x)"

config SENSORARRAY_SPI_USE_DMA
    bool "Enable SPI DMA where possible"
    default y

config SENSORARRAY_SPI_MAX_TRANSFER_BYTES
    int "SPI max transfer size (bytes)"
    default 64

endmenu

menu "ADS1263 direct diagnostics / gap fill"

config SENSORARRAY_ADS_GAP_FILL_ENABLE
    bool "Run AIN8/AIN9 direct diagnostics inside FDC ready windows"
    default y

config SENSORARRAY_ADS_START_GPIO
    int "ADS1263 START GPIO"
    default 48
    range 0 48

config SENSORARRAY_ADS_DRDY_GPIO
    int "ADS1263 DRDY GPIO"
    default 13
    range 0 48

config SENSORARRAY_ADS_DATA_RATE
    int "ADS1263 ADC1 data-rate register code"
    default 15
    range 0 15
    help
        15 selects 38400 SPS for ADC1. ADS1263 background jobs use ADC2 at 800 SPS.

config SENSORARRAY_ADS_GAP_GUARD_US
    int "Initial FDC deadline guard for ADS gap-fill (us)"
    default 500
    range 100 10000

config SENSORARRAY_ADS_JOB_WORST_CASE_US
    int "ADS direct-job admission worst case (us)"
    default 4000
    range 100 20000

config SENSORARRAY_ADS_DRDY_TIMEOUT_US
    int "ADS DRDY notification timeout (us)"
    default 600
    range 100 20000

config SENSORARRAY_ADS_AIN8_BATTERY_DIVIDER_NUM
    int "Battery/input ratio numerator for the 1:1 divider"
    default 2
    range 0 100000

config SENSORARRAY_ADS_AIN8_BATTERY_DIVIDER_DEN
    int "AIN8 battery divider denominator"
    default 1
    range 1 100000

config SENSORARRAY_ADS_BATTERY_MIN_MV
    int "Minimum plausible battery voltage (mV)"
    default 2500
    range 0 20000

config SENSORARRAY_ADS_BATTERY_MAX_MV
    int "Maximum plausible battery voltage (mV)"
    default 5000
    range 0 20000

config SENSORARRAY_ADS_AVSS_TO_GND_UV
    int "Magnitude of AVSS below GND (uV)"
    default 1800000
    range 0 5000000

config SENSORARRAY_ADS_AVDD_TO_GND_UV
    int "AVDD above GND (uV)"
    default 3300000
    range 0 5000000
    help
        With ADS126x AINCOM level shift enabled, AINCOM-to-GND is calculated
        explicitly as the AVDD/AVSS midpoint. A validated measured rail scales
        the nominal AVDD-to-GND and AVSS-to-GND split before that calculation.

config SENSORARRAY_ADS_RAIL_EXPECTED_TOLERANCE_UV
    int "Allowed rail-monitor error from configured AVDD-AVSS (uV)"
    default 250000
    range 10000 2000000
    help
        The ADS126x analog supply monitor is measured against the internal
        reference and scaled by four. Battery calculation accepts this rail
        only when it is close to AVDD_TO_GND + AVSS_TO_GND.

config SENSORARRAY_ADS_ZERO_PERIOD_FRAMES
    int "AIN9-AINCOM residual measurement period"
    default 100
    range 1 100000

config SENSORARRAY_ADS_RAIL_PERIOD_FRAMES
    int "Analog supply monitor period"
    default 500
    range 1 100000

endmenu

menu "Matrix defaults"

config SENSORARRAY_MATRIX_ROWS
    int "Matrix rows"
    default 8

config SENSORARRAY_MATRIX_COLS
    int "Matrix cols"
    default 8

config SENSORARRAY_OVERSAMPLE
    int "Oversample count per point"
    default 1

config SENSORARRAY_MEASURE_LOCK_TIMEOUT_MS
    int "Measurement lock timeout (ms)"
    default 5000
    range 1 60000

endmenu

menu "I2C recovery"

config SENSORARRAY_I2C_RECOVER_ON_TIMEOUT
    bool "Recover I2C bus after timeout when pins look stuck"
    default n

endmenu

endmenu
```

## main/kconfigs/Kconfig.compat
```kconfig
menu "Compat"

# Hidden legacy symbols are kept only so older sdkconfig files can migrate.
# Business code must use SENSORARRAY_CFG_* or the new category symbols.

config SENSORARRAY_ENABLE_WIRED
    bool
    default SENSORARRAY_OUTPUT_USB_TEXT

config SENSORARRAY_ENABLE_BLE
    bool
    default SENSORARRAY_OUTPUT_BLE_CAP_TEXT

config SENSORARRAY_BLE_ENABLE
    bool
    default SENSORARRAY_OUTPUT_BLE_CAP_TEXT

config SENSORARRAY_FDC_CAP_PRINT_DECIMALS
    int
    default SENSORARRAY_CAP_DECIMALS

config SENSORARRAY_FDC_CAP_DECIMALS
    int
    default SENSORARRAY_CAP_DECIMALS

config SENSORARRAY_FDC_MATRIX_TARGET_FPS
    int
    default SENSORARRAY_TARGET_FPS

config SENSORARRAY_FDC_MATRIX_PERIOD_MS
    int
    default 50

config SENSORARRAY_FRAME_PERIOD_MS
    int
    default 50

config SENSORARRAY_FDC_TEXT_OUTPUT_FREQ_HZ
    bool
    default SENSORARRAY_FDC_TEXT_FREQ_HZ

config SENSORARRAY_FDC_TEXT_OUTPUT_CAP_TOTAL_PF
    bool
    default SENSORARRAY_FDC_TEXT_CAP_TOTAL_PF

config SENSORARRAY_FDC_TEXT_OUTPUT_BOTH_SEPARATE
    bool
    default SENSORARRAY_FDC_TEXT_BOTH_SEPARATE

config SENSORARRAY_FDC_TEXT_OUTPUT_BOTH_INLINE_DEBUG
    bool
    default SENSORARRAY_FDC_TEXT_BOTH_INLINE_DEBUG

config SENSORARRAY_FDC_RUNTIME_PROFILE_BALANCED
    bool
    default SENSORARRAY_FDC_RUNTIME_PROFILE_BALANCED_20FPS

config SENSORARRAY_FDC_RUNTIME_PROFILE_FAST
    bool
    default SENSORARRAY_FDC_RUNTIME_PROFILE_FAST_RUNTIME

endmenu
```
